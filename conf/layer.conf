## conf/layer.conf
```bitbake
# We have a conf and classes directory, add to BBPATH
BBPATH .= ":${LAYERDIR}"

# We have a packages directory, add to BBFILES
BBFILES += " \
    ${LAYERDIR}/recipes-*/*/*.bb \
    ${LAYERDIR}/recipes-*/*/*.bbappend \
    "

BBFILES_DYNAMIC += " \
xilinx:${LAYERDIR}/dynamic-layers/xilinx-core/recipes-*/*/*.bb \
xilinx:${LAYERDIR}/dynamic-layers/xilinx-core/recipes-*/*/*.bbappend \
xilinx-tools:${LAYERDIR}/dynamic-layers/xilinx-tools/recipes-*/*/*.bb \
xilinx-tools:${LAYERDIR}/dynamic-layers/xilinx-tools/recipes-*/*/*.bbappend \
petalinux:${LAYERDIR}/dynamic-layers/petalinux/recipes-*/*/*.bb \
petalinux:${LAYERDIR}/dynamic-layers/petalinux/recipes-*/*/*.bbappend \
openamp-layer:${LAYERDIR}/dynamic-layers/openamp-layer/recipes-*/*/*.bb \
openamp-layer:${LAYERDIR}/dynamic-layers/openamp-layer/recipes-*/*/*.bbappend \
xilinx-standalone-sdt:${LAYERDIR}/dynamic-layers/xilinx-standalone-sdt/recipes-*/*/*.bb \
xilinx-standalone-sdt:${LAYERDIR}/dynamic-layers/xilinx-standalone-sdt/recipes-*/*/*.bbappend \
xilinx-standalone-sdt:${LAYERDIR}/dynamic-layers/xilinx-standalone-sdt/recipes-*/*.bb \
xilinx-standalone-sdt:${LAYERDIR}/dynamic-layers/xilinx-standalone-sdt/recipes-*/*.bbappend \
"

BBFILE_COLLECTIONS += "kria"
BBFILE_PRIORITY_kria = "5"
BBFILE_PATTERN_kria = "^${LAYERDIR}/"
BBFILE_PATTERN_IGNORE_EMPTY_kria = "1"

LAYERDEPENDS_kria  = "core xilinx"

LAYERRECOMMENDS_kria = "xilinx-tools"

LAYERSERIES_COMPAT_kria = "scarthgap"

LAYER_PATH_kria-layer = "${LAYERDIR}"

PREFERRED_VERSION_imgrcry-make = "${@d.getVar("XILINX_RELEASE_VERSION").replace('v','')}%"
```

## conf/machine/include/k24-sm.inc
```bitbake
#### Preamble
MACHINEOVERRIDES =. "${@['', 'k24-sm:']['k24-sm' != '${MACHINE}']}"
#### Regular settings follow

YAML_DT_BOARD_FLAGS ?= "{BOARD zynqmp-sm-k24-reva}"

require conf/machine/include/k24-kria-common.inc

#### No additional settings should be after the Postamble
#### Postamble
PACKAGE_EXTRA_ARCHS:append = "${@['', ' k24_sm']['k24-sm' != "${MACHINE}"]}"
```

## conf/machine/include/k24-smk-kd-sdt/k24-smk-kd-sdt-cortexr5-0-freertos-features.conf
```bitbake
MACHINE_FEATURES = "avbuf axipmon canps clockps common coresightps-dcc csudma ddrcpsu dpdma dppsu emacps gpiops iicps ipipsu qspipsu resetps rtcpsu scugic spips sysmonpsu ttcps uartps usbpsu video-common wdtps zdma"
```

## conf/machine/include/k24-smk-kd-sdt/k24-smk-kd-sdt-microblaze-pmu-features.conf
```bitbake
MACHINE_FEATURES = "avbuf axipmon canps clockps common csudma ddrcpsu dpdma dppsu emacps gpiops iicps ipipsu qspipsu resetps rtcpsu spips sysmonpsu ttcps uartps usbpsu video-common wdtps zdma"
```

## conf/machine/include/k24-smk-kd-sdt/k24-smk-kd-sdt-microblaze-pmu-libxil.conf
```bitbake
PACKAGECONFIG[avbuf] = "${RECIPE_SYSROOT}/usr/lib/libavbuf.a,,avbuf,,"
PACKAGECONFIG[axipmon] = "${RECIPE_SYSROOT}/usr/lib/libaxipmon.a,,axipmon,,"
PACKAGECONFIG[canps] = "${RECIPE_SYSROOT}/usr/lib/libcanps.a,,canps,,"
PACKAGECONFIG[clockps] = "${RECIPE_SYSROOT}/usr/lib/libclockps.a,,clockps,,"
PACKAGECONFIG[common] = "${RECIPE_SYSROOT}/usr/lib/libcommon.a,,common,,"
PACKAGECONFIG[csudma] = "${RECIPE_SYSROOT}/usr/lib/libcsudma.a,,csudma,,"
PACKAGECONFIG[ddrcpsu] = "${RECIPE_SYSROOT}/usr/lib/libddrcpsu.a,,ddrcpsu,,"
PACKAGECONFIG[dpdma] = "${RECIPE_SYSROOT}/usr/lib/libdpdma.a,,dpdma,,"
PACKAGECONFIG[dppsu] = "${RECIPE_SYSROOT}/usr/lib/libdppsu.a,,dppsu,,"
PACKAGECONFIG[emacps] = "${RECIPE_SYSROOT}/usr/lib/libemacps.a,,emacps,,"
PACKAGECONFIG[gpiops] = "${RECIPE_SYSROOT}/usr/lib/libgpiops.a,,gpiops,,"
PACKAGECONFIG[iicps] = "${RECIPE_SYSROOT}/usr/lib/libiicps.a,,iicps,,"
PACKAGECONFIG[ipipsu] = "${RECIPE_SYSROOT}/usr/lib/libipipsu.a,,ipipsu,,"
PACKAGECONFIG[qspipsu] = "${RECIPE_SYSROOT}/usr/lib/libqspipsu.a,,qspipsu,,"
PACKAGECONFIG[resetps] = "${RECIPE_SYSROOT}/usr/lib/libresetps.a,,resetps,,"
PACKAGECONFIG[rtcpsu] = "${RECIPE_SYSROOT}/usr/lib/librtcpsu.a,,rtcpsu,,"
PACKAGECONFIG[spips] = "${RECIPE_SYSROOT}/usr/lib/libspips.a,,spips,,"
PACKAGECONFIG[sysmonpsu] = "${RECIPE_SYSROOT}/usr/lib/libsysmonpsu.a,,sysmonpsu,,"
PACKAGECONFIG[ttcps] = "${RECIPE_SYSROOT}/usr/lib/libttcps.a,,ttcps,,"
PACKAGECONFIG[uartps] = "${RECIPE_SYSROOT}/usr/lib/libuartps.a,,uartps,,"
PACKAGECONFIG[usbpsu] = "${RECIPE_SYSROOT}/usr/lib/libusbpsu.a,,usbpsu,,"
PACKAGECONFIG[video-common] = "${RECIPE_SYSROOT}/usr/lib/libvideo_common.a,,video-common,,"
PACKAGECONFIG[wdtps] = "${RECIPE_SYSROOT}/usr/lib/libwdtps.a,,wdtps,,"
PACKAGECONFIG[zdma] = "${RECIPE_SYSROOT}/usr/lib/libzdma.a,,zdma,,"
```

## conf/machine/include/k24-smk.inc
```bitbake
#### Preamble
MACHINEOVERRIDES =. "${@['', 'k24-smk:']['k24-smk' != '${MACHINE}']}"
#### Regular settings follow

UBOOT_DT_FILES ?= "\
    zynqmp-sck-kd-g-revA.dtso \
    zynqmp-sck-kv-g-revA.dtso \
    zynqmp-sck-kv-g-revB.dtso \
    "


require conf/machine/include/k24-kria-common.inc

EXTRA_IMAGEDEPENDS += "kria-qspi"

#### No additional settings should be after the Postamble
#### Postamble
PACKAGE_EXTRA_ARCHS:append = "${@['', ' k24_smk']['k24-smk' != "${MACHINE}"]}"
```

## conf/machine/include/k24c-sm-sdt/k24c-sm-sdt-microblaze-pmu-features.conf
```bitbake
MACHINE_FEATURES = "avbuf axipmon clockps common csudma ddrcpsu dpdma dppsu gpiops iicps ipipsu qspipsu resetps rtcpsu sdps spips sysmonpsu ttcps uartps video-common wdtps zdma"
```

## conf/machine/include/k24c-sm-sdt/k24c-sm-sdt-microblaze-pmu-libxil.conf
```bitbake
PACKAGECONFIG[avbuf] = "${RECIPE_SYSROOT}/usr/lib/libavbuf.a,,avbuf,,"
PACKAGECONFIG[axipmon] = "${RECIPE_SYSROOT}/usr/lib/libaxipmon.a,,axipmon,,"
PACKAGECONFIG[clockps] = "${RECIPE_SYSROOT}/usr/lib/libclockps.a,,clockps,,"
PACKAGECONFIG[common] = "${RECIPE_SYSROOT}/usr/lib/libcommon.a,,common,,"
PACKAGECONFIG[csudma] = "${RECIPE_SYSROOT}/usr/lib/libcsudma.a,,csudma,,"
PACKAGECONFIG[ddrcpsu] = "${RECIPE_SYSROOT}/usr/lib/libddrcpsu.a,,ddrcpsu,,"
PACKAGECONFIG[dpdma] = "${RECIPE_SYSROOT}/usr/lib/libdpdma.a,,dpdma,,"
PACKAGECONFIG[dppsu] = "${RECIPE_SYSROOT}/usr/lib/libdppsu.a,,dppsu,,"
PACKAGECONFIG[gpiops] = "${RECIPE_SYSROOT}/usr/lib/libgpiops.a,,gpiops,,"
PACKAGECONFIG[iicps] = "${RECIPE_SYSROOT}/usr/lib/libiicps.a,,iicps,,"
PACKAGECONFIG[ipipsu] = "${RECIPE_SYSROOT}/usr/lib/libipipsu.a,,ipipsu,,"
PACKAGECONFIG[qspipsu] = "${RECIPE_SYSROOT}/usr/lib/libqspipsu.a,,qspipsu,,"
PACKAGECONFIG[resetps] = "${RECIPE_SYSROOT}/usr/lib/libresetps.a,,resetps,,"
PACKAGECONFIG[rtcpsu] = "${RECIPE_SYSROOT}/usr/lib/librtcpsu.a,,rtcpsu,,"
PACKAGECONFIG[sdps] = "${RECIPE_SYSROOT}/usr/lib/libsdps.a,,sdps,,"
PACKAGECONFIG[spips] = "${RECIPE_SYSROOT}/usr/lib/libspips.a,,spips,,"
PACKAGECONFIG[sysmonpsu] = "${RECIPE_SYSROOT}/usr/lib/libsysmonpsu.a,,sysmonpsu,,"
PACKAGECONFIG[ttcps] = "${RECIPE_SYSROOT}/usr/lib/libttcps.a,,ttcps,,"
PACKAGECONFIG[uartps] = "${RECIPE_SYSROOT}/usr/lib/libuartps.a,,uartps,,"
PACKAGECONFIG[video-common] = "${RECIPE_SYSROOT}/usr/lib/libvideo_common.a,,video-common,,"
PACKAGECONFIG[wdtps] = "${RECIPE_SYSROOT}/usr/lib/libwdtps.a,,wdtps,,"
PACKAGECONFIG[zdma] = "${RECIPE_SYSROOT}/usr/lib/libzdma.a,,zdma,,"
```

## conf/machine/include/k24i-sm-sdt/k24i-sm-sdt-cortexr5-1-baremetal-features.conf
```bitbake
MACHINE_FEATURES = "avbuf axipmon clockps common coresightps-dcc csudma ddrcpsu dpdma dppsu gpiops iicps ipipsu qspipsu resetps rtcpsu scugic sdps spips sysmonpsu ttcps uartps video-common wdtps zdma"
```

## conf/machine/include/k26-kria-common.inc
```bitbake
MACHINEOVERRIDES =. "k26-kria:"

MACHINE_HWCODECS = "libomxil-xlnx"

require conf/machine/zynqmp-ev-generic.conf
require conf/machine/include/kria-common.inc

QB_OPT_APPEND += "-hw-dtb ${DEPLOY_DIR_IMAGE}/qemu-hw-devicetrees/multiarch/board-zynqmp-k26-starterkit-virt.dtb"
```

## conf/machine/include/k26-sm.inc
```bitbake
MACHINEOVERRIDES =. "${@['', 'k26-sm:']['k26-sm' != '${MACHINE}']}"

YAML_DT_BOARD_FLAGS ?= "{BOARD zynqmp-sm-k26-reva}"

require conf/machine/include/k26-kria-common.inc

#### No additional settings should be after the Postamble
#### Postamble
PACKAGE_EXTRA_ARCHS:append = "${@['', ' k26_sm']['k26-sm' != "${MACHINE}"]}"
```

## conf/machine/include/k26-smk-kv-sdt/k26-smk-kv-sdt-cortexr5-1-baremetal-features.conf
```bitbake
MACHINE_FEATURES = "avbuf axipmon clockps common coresightps-dcc csudma ddrcpsu dpdma dppsu emacps gpiops iicps ipipsu qspipsu resetps rtcpsu scugic sdps spips sysmonpsu ttcps uartps usbpsu video-common wdtps zdma"
```

## conf/machine/include/k26-smk-kv-sdt/k26-smk-kv-sdt-microblaze-pmu-features.conf
```bitbake
MACHINE_FEATURES = "avbuf axipmon clockps common csudma ddrcpsu dpdma dppsu emacps gpiops iicps ipipsu qspipsu resetps rtcpsu sdps spips sysmonpsu ttcps uartps usbpsu video-common wdtps zdma"
```

## conf/machine/include/k26-smk.inc
```bitbake
#### Preamble
MACHINEOVERRIDES =. "${@['', 'k26-smk:']['k26-smk' != '${MACHINE}']}"
#### Regular settings follow

UBOOT_DT_FILES ?= "\
    zynqmp-sck-kr-g-revA.dtso \
    zynqmp-sck-kr-g-revB.dtso \
    zynqmp-sck-kv-g-revA.dtso \
    zynqmp-sck-kv-g-revB.dtso \
    "

require conf/machine/include/k26-kria-common.inc

EXTRA_IMAGEDEPENDS += "kria-qspi"

#### No additional settings should be after the Postamble
#### Postamble
PACKAGE_EXTRA_ARCHS:append = "${@['', ' k26_smk']['k26-smk' != "${MACHINE}"]}"
```

## conf/machine/include/kria-common.inc
```bitbake
# This file should not use ?=, and should be included AFTER the base soc-variant
MACHINEOVERRIDES =. "kria:"

SPL_BINARY = ""

IMAGE_CLASSES += "kria-image"

ATF_CONSOLE ?= "cadence1"

YAML_SERIAL_CONSOLE_BAUDRATE = "115200"

SERIAL_CONSOLES = "115200;ttyPS1"

IMGRCRY_DEPENDS = "${@'image-recovery-make:do_deploy' if d.getVar('XILINX_WITH_ESW') == 'xsct' else ''}"

EXTRA_IMAGEDEPENDS += "board-id-data"
EXTRA_IMAGEDEPENDS:remove = "virtual/boot-bin u-boot-xlnx-uenv"

IMAGE_FSTYPES += " ext4 wic wic.xz wic.qemu-sd"

KERNEL_COMMAND_APPEND ?= "root=LABEL=root"

UBOOT_MACHINE = "xilinx_zynqmp_kria_defconfig"

MACHINE_ESSENTIAL_EXTRA_RDEPENDS += "${PREFERRED_PROVIDER_virtual/dtb}"

# Default values for deploy dirs
FSBL_DEPLOY_DIR ??= "${DEPLOY_DIR_IMAGE}"
PMU_FIRMWARE_DEPLOY_DIR ??= "${DEPLOY_DIR_IMAGE}"
```

## conf/machine/include/kria-qemu-common.inc
```bitbake
# QEMU specific dependencies

EXTRA_IMAGEDEPENDS += " \
    virtual/arm-trusted-firmware \
    virtual/fsbl \
    virtual/pmu-firmware \
"

# QEMU options
QB_DEFAULT_FSTYPE = "wic.qemu-sd"

# qspi 32-bit
QEMU_HW_BOOT_MODE = "2"

# The fit will load, but we also need some additional components
QEMU_DTB_LOAD = "-device loader,file=@DEPLOY_DIR_IMAGE@/fit-dtb.blob,addr=0x100000,force-raw=on"

# Additional items required for booting
QB_OPT_APPEND += " \
    -blockdev node-name=pmu-cfg,filename=@DEPLOY_DIR_IMAGE@/pmu-conf.bin,driver=file \
    -global xlnx,zynqmp-boot.drive=pmu-cfg \
    "

# runqemu assumes the first serial device is used but Kria SOM uses the second, the following line is
# required in order to mark the first serial as inactive as the runqemu serial config is appended
QEMU_HW_SERIAL = " -serial null -serial mon:stdio"
```

## conf/machine/include/kria-qemu-kd.inc
```bitbake
require kria-qemu-common.inc

QB_ROOTFS_OPT = "-drive file=@ROOTFS@,if=none,format=raw,id=stick"

QB_NETWORK_DEVICE = "-net nic -net nic,netdev=net0,macaddr=@MAC@"

QEMU_HW_DTB_PS = "${QEMU_HW_DTB_PATH}/board-zynqmp-kd240.dtb"

QB_OPT_APPEND += " \
    -device usb-hub,bus=usb3@0xFE200000.0,port=1,id=usb-hub \
    -device usb-storage,bus=usb3@0xFE200000.0,port=1.1,id=usbstick,drive=stick \
    -blockdev filename=@DEPLOY_DIR_IMAGE@/kd-eeprom.bin,node-name=i2c1.eeprom-51,driver=file \
    -blockdev filename=@DEPLOY_DIR_IMAGE@/som-k24-eeprom.bin,node-name=i2c1.eeprom-50,driver=file \
"
QB_PMU_OPT = "     -M microblaze-fdt     -display none     -hw-dtb @DEPLOY_DIR_IMAGE@/${QEMU_HW_DTB_PATH}/zynqmp-pmu.dtb   -kernel @DEPLOY_DIR_IMAGE@/pmu-rom.elf     -device loader,file=@DEPLOY_DIR_IMAGE@/pmu-firmware-k24-smk-kd-sdt.elf     -device loader,addr=0xfd1a0074,data=0x1011003,data-len=4     -device loader,addr=0xfd1a007C,data=0x1010f03,data-len=4     "
```

## conf/machine/include/kria-qemu-kr.inc
```bitbake
require kria-qemu-common.inc

QB_NETWORK_DEVICE = "-net nic -net nic,netdev=net0,macaddr=@MAC@"

QEMU_HW_DTB_PS = "${QEMU_HW_DTB_PATH}/board-zynqmp-k26-starterkit-virt.dtb" 

QB_OPT_APPEND += "\
    -device usb-hub,bus=usb3@0xFE200000.0,port=1,id=usb-hub \
    -device usb-storage,bus=usb3@0xFE200000.0,port=1.1,id=usbstick,drive=stick \
    -blockdev filename=@DEPLOY_DIR_IMAGE@/kr-eeprom.bin,node-name=i2c1.eeprom-51,driver=file \
"

QB_ROOTFS_OPT = "-drive file=@ROOTFS@,if=none,format=raw,id=stick"
```

## conf/machine/include/kria-qemu-kv.inc
```bitbake
require kria-qemu-common.inc

QEMU_HW_DTB_PS = "${QEMU_HW_DTB_PATH}/board-zynqmp-kv260.dtb"

QB_OPT_APPEND += "\ 
    -blockdev filename=@DEPLOY_DIR_IMAGE@/kv-eeprom.bin,node-name=i2c1.eeprom-51,driver=file \
    -blockdev filename=@DEPLOY_DIR_IMAGE@/som-k26-eeprom.bin,node-name=i2c1.eeprom-50,driver=file \
"

QB_ROOTFS_OPT = "-drive file=@ROOTFS@,if=sd,format=raw,index=1"

QB_PMU_OPT = "     -M microblaze-fdt     -display none     -hw-dtb @DEPLOY_DIR_IMAGE@/${QEMU_HW_DTB_PATH}/zynqmp-pmu.dtb   -kernel @DEPLOY_DIR_IMAGE@/pmu-rom.elf     -device loader,file=@DEPLOY_DIR_IMAGE@/pmu-firmware-k26-smk-kv-sdt.elf     -device loader,addr=0xfd1a0074,data=0x1011003,data-len=4     -device loader,addr=0xfd1a007C,data=0x1010f03,data-len=4     "
```

## conf/machine/k24-sm.conf
```bitbake
#@TYPE: Machine
#@NAME: Generic k24-sm
#@DESCRIPTION: Kria K24 SM Production SOM

require include/k24-sm.inc
```
