## conf/machine/k24-smk-kd-sdt-multidomain.conf
```bitbake
#@TYPE: Machine
#@NAME: k24-smk-kd-sdt-multidomain
#@DESCRIPTION: AMP/multidomain machine for the AMD Kria KD240 Drives Starter Kit (K24 SOM): Cortex-A53 Linux plus Cortex-A53 baremetal, Cortex-R5 FreeRTOS/baremetal, and MicroBlaze PMU sub-machines, built from system device tree.

BBMULTICONFIG += "k24-smk-kd-sdt-multidomain-cortexa53-fsbl k24-smk-kd-sdt-multidomain-cortexa53-0-baremetal k24-smk-kd-sdt-multidomain-cortexr5-0-freertos k24-smk-kd-sdt-multidomain-cortexr5-1-baremetal k24-smk-kd-sdt-multidomain-microblaze-pmu"
MACHINEOVERRIDES .= ":k24-smk-kd-sdt"

#### Preamble
MACHINEOVERRIDES =. "${@['', 'k24-smk-kd-sdt-multidomain:']['k24-smk-kd-sdt-multidomain' !='${MACHINE}']}"
#### Regular settings follow
TUNEFILE[microblaze-pmu] = "conf/machine/include/k24-smk-kd-sdt-multidomain/microblaze.inc"

# First Stage Boot Loader
FSBL_DEPENDS = ""
FSBL_MCDEPENDS = "mc::k24-smk-kd-sdt-multidomain-cortexa53-fsbl:fsbl-firmware:do_deploy"
FSBL_DEPLOY_DIR = "${TMPDIR}-k24-smk-kd-sdt-multidomain-cortexa53-fsbl/deploy/images/${MACHINE}"

# PMU Firmware
PMU_DEPENDS = ""
PMU_MCDEPENDS = "mc::k24-smk-kd-sdt-multidomain-microblaze-pmu:pmu-firmware:do_deploy"
PMU_FIRMWARE_DEPLOY_DIR = "${TMPDIR}-k24-smk-kd-sdt-multidomain-microblaze-pmu/deploy/images/${MACHINE}"

# Set the default (linux) domain device tree
CONFIG_DTFILE_DIR := "${@bb.utils.which(d.getVar('BBPATH'), 'conf/dts/k24-smk-kd-sdt-multidomain')}"
CONFIG_DTFILE ?= "${CONFIG_DTFILE_DIR}/cortexa53-linux.dts"
CONFIG_DTFILE[vardepsexclude] += "CONFIG_DTFILE_DIR"

# Device tree binary for boot image
DTB_FILE_PATH ?= "${RECIPE_SYSROOT}/boot/devicetree/SMK-zynqmp-sck-kd-g-revA.dtb"

# Serial Console Settings
SERIAL_CONSOLES ?= "115200;ttyPS0"

# Yocto arm-trusted-firmware(TF-A) variables
TFA_CONSOLE ?= "cadence"
TFA_BL33_LOAD ?= "0x8000000"

# Yocto u-boot-xlnx variables

# Set DDR Base address for u-boot-xlnx-scr variables
DDR_BASEADDR ?= "0x0"
SKIP_APPEND_BASEADDR ?= "0"

# Yocto KERNEL Variables
UBOOT_ENTRYPOINT ?= "0x200000"
UBOOT_LOADADDRESS ?= "0x200000"

# Yocto MACHINE_FEATURES Variable
MACHINE_FEATURES += "mali400 fpga-overlay efi"

# Required generic machine inclusion
require conf/machine/include/k24-smk.inc

# K24 + KD240
require conf/machine/include/kria-qemu-kd.inc
UBOOT_DT_FILES = "zynqmp-sck-kd-g-revA.dtso"
DTB_FILE_NAME:task-install:pn-device-tree:linux = "${UBOOT_DTFILE_PREFIX}-zynqmp-sck-kd-g-revA.dtb"
DTB_FILE_NAME:task-deploy:pn-device-tree:linux = "${UBOOT_DTFILE_PREFIX}-zynqmp-sck-kd-g-revA.dtb"
PR:append:pn-device-tree = ".2"
QEMU_FLASH_TYPE = "qspi"
QEMU_FLASH_FILE = "kria-qspi-${MACHINE}"
# QSPI flash size (64MB)
SPI_IMAGE_SIZE = "0x400_0000"
# QSPI Boots from offset (0x20_0000)
QEMU_HW_FLASH:append = " -boot multiboot=${@int(int('0x20_0000', 0) / ( 32 * 1024))}"
# Baremetal Image-recovery requires xilffs with ramfs support
PACKAGECONFIG:append:pn-xilffs = " ramfs"

# This is an 'SDT' based BSP
XILINX_WITH_ESW = "sdt"

# Original SDT artifacts URL
SDT_URI = "https://edf.amd.com/sswreleases/rel-v2026.1/sdt/2026.1/2026.1_0609_1_06092108/external/k24-smk-kd-sdt/k24-smk-kd-sdt_2026.1_0609_1_06092108.tar.gz"
SDT_URI[sha256sum] = "6fc8cf3548b6ac9febbf9ae0f5ee5d69fadc4853a2cf33f242801baab3737977"
SDT_URI[S] = "${WORKDIR}/k24-smk-kd-sdt_2026.1_0609_1_06092108"

# Set the system device trees
SYSTEM_DTFILE_DEPENDS = "sdt-artifacts"
SYSTEM_DTFILE_DIR = "${RECIPE_SYSROOT}${datadir}/sdt/${MACHINE}"
SYSTEM_DTFILE = "${SYSTEM_DTFILE_DIR}/system-top.dts"

# Load the dynamic machine features
include conf/machine/include/k24-smk-kd-sdt-multidomain/${BB_CURRENT_MC}-features.conf
LIBXIL_CONFIG = "conf/machine/include/k24-smk-kd-sdt-multidomain/${BB_CURRENT_MC}-libxil.conf"

# Primary Bootmode value
DEFAULT_HW_BOOT_MODE = "2"

# Update bootbin to use proper device tree
BIF_PARTITION_IMAGE[device-tree] = "${DTB_FILE_PATH}"

# Remap boot files to ensure the right device tree is listed first
IMAGE_BOOT_FILES =+ "devicetree/${@os.path.basename(d.getVar('CONFIG_DTFILE').replace('.dts', '.dtb'))}"
PACKAGE_EXTRA_ARCHS:append = " k24_smk_kd_sdt"

#### No additional settings should be after the Postamble
#### Postamble
PACKAGE_EXTRA_ARCHS:append = "${@['', ' k24_smk_kd_sdt_multidomain']['k24-smk-kd-sdt-multidomain' != '${MACHINE}']}"
```

## conf/machine/k24-smk-kd-sdt.conf
```bitbake
#@TYPE: Machine
#@NAME: k24-smk-kd-sdt
#@DESCRIPTION: Machine configuration for the AMD Kria KD240 Drives Starter Kit (K24 SOM, Zynq UltraScale+ MPSoC): Cortex-A53 Linux plus FSBL and MicroBlaze PMU sub-machines, built from system device tree.

BBMULTICONFIG += "k24-smk-kd-sdt-cortexa53-fsbl k24-smk-kd-sdt-microblaze-pmu"

#### Preamble
MACHINEOVERRIDES =. "${@['', 'k24-smk-kd-sdt:']['k24-smk-kd-sdt' !='${MACHINE}']}"
#### Regular settings follow
TUNEFILE[microblaze-pmu] = "conf/machine/include/k24-smk-kd-sdt/microblaze.inc"

# First Stage Boot Loader
FSBL_DEPENDS = ""
FSBL_MCDEPENDS = "mc::k24-smk-kd-sdt-cortexa53-fsbl:fsbl-firmware:do_deploy"
FSBL_DEPLOY_DIR = "${TMPDIR}-k24-smk-kd-sdt-cortexa53-fsbl/deploy/images/${MACHINE}"

# PMU Firmware
PMU_DEPENDS = ""
PMU_MCDEPENDS = "mc::k24-smk-kd-sdt-microblaze-pmu:pmu-firmware:do_deploy"
PMU_FIRMWARE_DEPLOY_DIR = "${TMPDIR}-k24-smk-kd-sdt-microblaze-pmu/deploy/images/${MACHINE}"

# Set the default (linux) domain device tree
CONFIG_DTFILE_DIR := "${@bb.utils.which(d.getVar('BBPATH'), 'conf/dts/k24-smk-kd-sdt')}"
CONFIG_DTFILE ?= "${CONFIG_DTFILE_DIR}/cortexa53-linux.dts"
CONFIG_DTFILE[vardepsexclude] += "CONFIG_DTFILE_DIR"

# Device tree binary for boot image
DTB_FILE_PATH ?= "${RECIPE_SYSROOT}/boot/devicetree/SMK-zynqmp-sck-kd-g-revA.dtb"

# Serial Console Settings
SERIAL_CONSOLES ?= "115200;ttyPS0"

# Yocto arm-trusted-firmware(TF-A) variables
TFA_CONSOLE ?= "cadence"
TFA_BL33_LOAD ?= "0x8000000"

# Yocto u-boot-xlnx variables

# Set DDR Base address for u-boot-xlnx-scr variables
DDR_BASEADDR ?= "0x0"
SKIP_APPEND_BASEADDR ?= "0"

# Yocto KERNEL Variables
UBOOT_ENTRYPOINT ?= "0x200000"
UBOOT_LOADADDRESS ?= "0x200000"

# Yocto MACHINE_FEATURES Variable
MACHINE_FEATURES += "mali400 fpga-overlay efi"

# Required generic machine inclusion
require conf/machine/include/k24-smk.inc

# K24 + KD240
require conf/machine/include/kria-qemu-kd.inc
UBOOT_DT_FILES = "zynqmp-sck-kd-g-revA.dtso"
DTB_FILE_NAME:task-install:pn-device-tree:linux = "${UBOOT_DTFILE_PREFIX}-zynqmp-sck-kd-g-revA.dtb"
DTB_FILE_NAME:task-deploy:pn-device-tree:linux = "${UBOOT_DTFILE_PREFIX}-zynqmp-sck-kd-g-revA.dtb"
PR:append:pn-device-tree = ".2"
QEMU_FLASH_TYPE = "qspi"
QEMU_FLASH_FILE = "kria-qspi-${MACHINE}"
# QSPI flash size (64MB)
SPI_IMAGE_SIZE = "0x400_0000"
# QSPI Boots from offset (0x20_0000)
QEMU_HW_FLASH:append = " -boot multiboot=${@int(int('0x20_0000', 0) / ( 32 * 1024))}"

# This is an 'SDT' based BSP
XILINX_WITH_ESW = "sdt"

# Original SDT artifacts URL
SDT_URI = "https://edf.amd.com/sswreleases/rel-v2026.1/sdt/2026.1/2026.1_0609_1_06092108/external/k24-smk-kd-sdt/k24-smk-kd-sdt_2026.1_0609_1_06092108.tar.gz"
SDT_URI[sha256sum] = "6fc8cf3548b6ac9febbf9ae0f5ee5d69fadc4853a2cf33f242801baab3737977"
SDT_URI[S] = "${WORKDIR}/k24-smk-kd-sdt_2026.1_0609_1_06092108"

# Set the system device trees
SYSTEM_DTFILE_DEPENDS = "sdt-artifacts"
SYSTEM_DTFILE_DIR = "${RECIPE_SYSROOT}${datadir}/sdt/${MACHINE}"
SYSTEM_DTFILE = "${SYSTEM_DTFILE_DIR}/system-top.dts"

# Load the dynamic machine features
include conf/machine/include/k24-smk-kd-sdt/${BB_CURRENT_MC}-features.conf
LIBXIL_CONFIG = "conf/machine/include/k24-smk-kd-sdt/${BB_CURRENT_MC}-libxil.conf"

# Primary Bootmode value
DEFAULT_HW_BOOT_MODE = "2"

# Update bootbin to use proper device tree
BIF_PARTITION_IMAGE[device-tree] = "${DTB_FILE_PATH}"

# Remap boot files to ensure the right device tree is listed first
IMAGE_BOOT_FILES =+ "devicetree/${@os.path.basename(d.getVar('CONFIG_DTFILE').replace('.dts', '.dtb'))}"

#### No additional settings should be after the Postamble
#### Postamble
PACKAGE_EXTRA_ARCHS:append = "${@['', ' k24_smk_kd_sdt']['k24-smk-kd-sdt' != '${MACHINE}']}"
```

## conf/machine/k24-smk-kd.conf
```bitbake
#@TYPE: Machine
#@NAME: Generic Kria KD240 Drives Starter Kit
#@DESCRIPTION: Machine configuration for Kria KD240 Drives Starter Kit (Kria K24 SOM + KD240 carrier board).

#### Preamble
MACHINEOVERRIDES =. "${@['', 'k24-smk-kd:']['k24-smk-kd' != '${MACHINE}']}"
MACHINEOVERRIDES =. "k24-kd:"
#### Regular settings follow

require conf/machine/include/k24-smk.inc

INITRAMFS_IMAGE ?= "petalinux-initramfs-image"

# This is an 'XSCT' based BSP
XILINX_XSCT_VERSION = "2025.2"
XILINX_WITH_ESW = "xsct"

# Add system XSA
HDF_URI = 'https://edf.amd.com/sswreleases/rel-v2025.2/hdf-examples/2025.2/2025.2_1115_1_11150546/external/k24-smk-kd/k24-smk-kd-2025.2_1115_1.xsa'
HDF_URI[sha256sum] = '9d36d4079f1fa43179780e1ebf2fb43683a60c131f43ed65ff0876b3e4d88142'

UBOOT_DT_FILES = "zynqmp-sck-kd-g-revA.dtso"

# DTB_FILE_NAME cant be changed globally or it will break the build but we can modify it for these
# tasks specifically so that the resulting symlink points to the correct file for a specific board
DTB_FILE_NAME:task-install:pn-device-tree:linux = "${UBOOT_DTFILE_PREFIX}-zynqmp-sck-kd-g-revA.dtb"
DTB_FILE_NAME:task-deploy:pn-device-tree:linux = "${UBOOT_DTFILE_PREFIX}-zynqmp-sck-kd-g-revA.dtb"
# Workaround for bitbake not detecting the above change in the hash
PR:append:pn-device-tree = ".1"

#### No additional settings should be after the Postamble
#### Postamble
PACKAGE_EXTRA_ARCHS:append = "${@['', ' k24_smk_kd']['k24-smk-kd' != "${MACHINE}"]}"
```

## conf/machine/k24-smk.conf
```bitbake
#@TYPE: Machine
#@NAME: Generic Kria Starter Kit
#@DESCRIPTION: Kria K24 SMK Starter Kit SOM

require include/k24-smk.inc

# This is an 'XSCT' based BSP
XILINX_XSCT_VERSION = "2025.2"
XILINX_WITH_ESW = "xsct"

# Set Image Recovery Depends for XSCT machine
IMGRCRY_DEPENDS = "${@'image-recovery-make:do_deploy' if d.getVar('XILINX_WITH_ESW') == 'xsct' else ''}"

# Add system XSA
HDF_URI = 'https://edf.amd.com/sswreleases/rel-v2025.2/hdf-examples/2025.2/2025.2_1115_1_11150546/external/k24-smk/k24-smk-2025.2_1115_1.xsa'
HDF_URI[sha256sum] = 'c3f5ed3b89233febd7be6c58dc2d653bc89ae3767f29aadf6a1d4a1298a28749'

#FPGA manager Variables
MACHINE_FEATURES += "fpga-overlay"
```

## conf/machine/k24c-sm-sdt.conf
```bitbake
#@TYPE: Machine
#@NAME: k24c-sm-sdt
#@DESCRIPTION: Machine configuration for the AMD Kria K24 SOM (commercial grade, Zynq UltraScale+ MPSoC): Cortex-A53 Linux plus Cortex-R5 FreeRTOS/baremetal and MicroBlaze PMU sub-machines, built from system device tree.

BBMULTICONFIG += "k24c-sm-sdt-cortexa53-fsbl k24c-sm-sdt-cortexr5-0-freertos k24c-sm-sdt-cortexr5-1-baremetal k24c-sm-sdt-microblaze-pmu"

#### Preamble
MACHINEOVERRIDES =. "${@['', 'k24c-sm-sdt:']['k24c-sm-sdt' !='${MACHINE}']}"
#### Regular settings follow
TUNEFILE[microblaze-pmu] = "conf/machine/include/k24c-sm-sdt/microblaze.inc"

# First Stage Boot Loader
FSBL_DEPENDS = ""
FSBL_MCDEPENDS = "mc::k24c-sm-sdt-cortexa53-fsbl:fsbl-firmware:do_deploy"
FSBL_DEPLOY_DIR = "${TMPDIR}-k24c-sm-sdt-cortexa53-fsbl/deploy/images/${MACHINE}"

# PMU Firmware
PMU_DEPENDS = ""
PMU_MCDEPENDS = "mc::k24c-sm-sdt-microblaze-pmu:pmu-firmware:do_deploy"
PMU_FIRMWARE_DEPLOY_DIR = "${TMPDIR}-k24c-sm-sdt-microblaze-pmu/deploy/images/${MACHINE}"

# Set the default (linux) domain device tree
CONFIG_DTFILE_DIR := "${@bb.utils.which(d.getVar('BBPATH'), 'conf/dts/k24c-sm-sdt')}"
CONFIG_DTFILE ?= "${CONFIG_DTFILE_DIR}/cortexa53-linux.dts"
CONFIG_DTFILE[vardepsexclude] += "CONFIG_DTFILE_DIR"

DTB_FILE_PATH ?= "${RECIPE_SYSROOT}/boot/devicetree/${@os.path.basename(d.getVar('CONFIG_DTFILE').replace('.dts', '.dtb'))}"

# Serial Console Settings
SERIAL_CONSOLES ?= "115200;ttyPS0"

# Yocto arm-trusted-firmware(TF-A) variables
TFA_CONSOLE ?= "cadence1"
TFA_BL33_LOAD ?= "0x8000000"

# Yocto u-boot-xlnx variables

# Set DDR Base address for u-boot-xlnx-scr variables
DDR_BASEADDR ?= "0x0"
SKIP_APPEND_BASEADDR ?= "0"

# Yocto KERNEL Variables
UBOOT_ENTRYPOINT ?= "0x200000"
UBOOT_LOADADDRESS ?= "0x200000"

# Yocto MACHINE_FEATURES Variable
MACHINE_FEATURES += "mali400 fpga-overlay efi"

# Required generic machine inclusion
require conf/machine/include/k24-sm.inc

QEMU_FLASH_TYPE = "qspi"
QEMU_FLASH_FILE = "kria-qspi-${MACHINE}"
# QSPI flash size (64MB)
SPI_IMAGE_SIZE = "0x400_0000"
# QSPI Boots from offset (0x20_0000)
QEMU_HW_FLASH:append = " -boot multiboot=${@int(int('0x20_0000', 0) / ( 32 * 1024))}"

# This is an 'SDT' based BSP
XILINX_WITH_ESW = "sdt"

# Original SDT artifacts URL
SDT_URI = "https://edf.amd.com/sswreleases/rel-v2026.1/sdt/2026.1/2026.1_0609_1_06092108/external/k24c-sm-sdt/k24c-sm-sdt_2026.1_0609_1_06092108.tar.gz"
SDT_URI[sha256sum] = "1a64443c26b59e4dade6f766193177c9d109b7bb5167d14f187ee8096cdb7c69"
SDT_URI[S] = "${WORKDIR}/k24c-sm-sdt_2026.1_0609_1_06092108"

# Set the system device trees
SYSTEM_DTFILE_DEPENDS = "sdt-artifacts"
SYSTEM_DTFILE_DIR = "${RECIPE_SYSROOT}${datadir}/sdt/${MACHINE}"
SYSTEM_DTFILE = "${SYSTEM_DTFILE_DIR}/system-top.dts"

# Load the dynamic machine features
include conf/machine/include/k24c-sm-sdt/${BB_CURRENT_MC}-features.conf
LIBXIL_CONFIG = "conf/machine/include/k24c-sm-sdt/${BB_CURRENT_MC}-libxil.conf"

# Primary Bootmode value
DEFAULT_HW_BOOT_MODE = "2"

# Update bootbin to use proper device tree
BIF_PARTITION_IMAGE[device-tree] = "${DTB_FILE_PATH}"

# Remap boot files to ensure the right device tree is listed first
IMAGE_BOOT_FILES =+ "devicetree/${@os.path.basename(d.getVar('CONFIG_DTFILE').replace('.dts', '.dtb'))}"

#### No additional settings should be after the Postamble
#### Postamble
PACKAGE_EXTRA_ARCHS:append = "${@['', ' k24c_sm_sdt']['k24c-sm-sdt' != '${MACHINE}']}"
```
