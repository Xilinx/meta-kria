## conf/machine/k24c-sm.conf
```bitbake
#@TYPE: Machine
#@NAME: Generic k24c-sm
#@DESCRIPTION: Kria K24c SM Production SOM

require include/k24-sm.inc

# This is an 'XSCT' based BSP
XILINX_XSCT_VERSION = "2025.2"
XILINX_WITH_ESW = "xsct"

# Add system XSA
HDF_URI = 'https://edf.amd.com/sswreleases/rel-v2025.2/hdf-examples/2025.2/2025.2_1115_1_11150546/external/k24c-sm/k24c-sm-2025.2_1115_1.xsa'
HDF_URI[sha256sum] = 'e3c1ead7e8dad7388c38f312e9c80a43007f7f42d2dbdfc816cdabad0c871f1a'
```

## conf/machine/k24i-sm-sdt.conf
```bitbake
#@TYPE: Machine
#@NAME: k24i-sm-sdt
#@DESCRIPTION: Machine configuration for the k24i-sm-sdt boards.

BBMULTICONFIG += "k24i-sm-sdt-cortexa53-fsbl k24i-sm-sdt-microblaze-pmu"

#### Preamble
MACHINEOVERRIDES =. "${@['', 'k24i-sm-sdt:']['k24i-sm-sdt' !='${MACHINE}']}"
#### Regular settings follow
TUNEFILE[microblaze-pmu] = "conf/machine/include/k24i-sm-sdt/microblaze.inc"

# First Stage Boot Loader
FSBL_DEPENDS = ""
FSBL_MCDEPENDS = "mc::k24i-sm-sdt-cortexa53-fsbl:fsbl-firmware:do_deploy"
FSBL_DEPLOY_DIR = "${TMPDIR}-k24i-sm-sdt-cortexa53-fsbl/deploy/images/${MACHINE}"

# PMU Firware
PMU_DEPENDS = ""
PMU_MCDEPENDS = "mc::k24i-sm-sdt-microblaze-pmu:pmu-firmware:do_deploy"
PMU_FIRMWARE_DEPLOY_DIR = "${TMPDIR}-k24i-sm-sdt-microblaze-pmu/deploy/images/${MACHINE}"

# Set the default (linux) domain device tree
CONFIG_DTFILE_DIR := "${@bb.utils.which(d.getVar('BBPATH'), 'conf/dts/k24i-sm-sdt')}"
CONFIG_DTFILE ?= "${CONFIG_DTFILE_DIR}/cortexa53-linux.dts"
CONFIG_DTFILE[vardepsexclude] += "CONFIG_DTFILE_DIR"

# Yocto arm-trusted-firmware(TF-A) variables
ATF_CONSOLE ?= "cadence1"
TFA_BL33_LOAD ?= "0x8000000"

# Set DDR Base address for u-boot-xlnx-scr variables
DDR_BASEADDR ?= "0x0"
SKIP_APPEND_BASEADDR ?= "0"

# Yocto KERNEL Variables
UBOOT_ENTRYPOINT  ?= "0x200000"
UBOOT_LOADADDRESS ?= "0x200000"

# Yocto MACHINE_FEATURES Variable
MACHINE_FEATURES += "fpga-overlay mali400"

# Required generic machine inclusion
require conf/machine/include/k24-sm.inc

# This is an 'SDT' based BSP
XILINX_WITH_ESW = "sdt"

# Original SDT artifacts URL
SDT_URI = "https://petalinux.xilinx.com/sswreleases/rel-v2024.2/sdt/2024.2/2024.2_1106_1_11061206/external/k24i-sm-sdt/k24i-sm-sdt_2024.2_1106_1.tar.gz"
SDT_URI[sha256sum] = "997e48fa56590475bbd63d6cf588f5f65d428097f297a40b2aa434c21e0b54d4"
SDT_URI[S] = "${WORKDIR}/k24i-sm-sdt_2024.2_1106_1"

# Set the system device trees
SYSTEM_DTFILE_DEPENDS = "sdt-artifacts"
SYSTEM_DTFILE_DIR = "${RECIPE_SYSROOT}${datadir}/sdt/${MACHINE}"
SYSTEM_DTFILE = "${SYSTEM_DTFILE_DIR}/system-top.dts"

# Load the dynamic machine features
include conf/machine/include/k24i-sm-sdt/${BB_CURRENT_MC}-features.conf
LIBXIL_CONFIG = "conf/machine/include/k24i-sm-sdt/${BB_CURRENT_MC}-libxil.conf"

# Update bootbin to use proper device tree
BIF_PARTITION_IMAGE[device-tree] = "${RECIPE_SYSROOT}/boot/devicetree/${@os.path.basename(d.getVar('CONFIG_DTFILE').replace('.dts', '.dtb'))}"

# Remap boot files to ensure the right device tree is listed first
IMAGE_BOOT_FILES =+ "devicetree/${@os.path.basename(d.getVar('CONFIG_DTFILE').replace('.dts', '.dtb'))}"

#### No additional settings should be after the Postamble
#### Postamble
PACKAGE_EXTRA_ARCHS:append = "${@['', ' k24i_sm_sdt']['k24i-sm-sdt' != '${MACHINE}']}"
```

## conf/machine/k24i-sm.conf
```bitbake
#@TYPE: Machine
#@NAME: Generic k24i-sm
#@DESCRIPTION: Kria K24i SM Production SOM

require include/k24-sm.inc

# This is an 'XSCT' based BSP
XILINX_XSCT_VERSION = "2025.2"
XILINX_WITH_ESW = "xsct"

# Add system XSA
HDF_URI = 'https://edf.amd.com/sswreleases/rel-v2025.2/hdf-examples/2025.2/2025.2_1115_1_11150546/external/k24i-sm/k24i-sm-2025.2_1115_1.xsa'
HDF_URI[sha256sum] = 'ebca97b6466879843f54225a70d35561383e113de5878b61ca984b0aaa25864b'
```

## conf/machine/k26-kv.conf
```bitbake
#@TYPE: Machine
#@NAME: Generic kv260 Starter Kit
#@DESCRIPTION: Kria K26 SOM + kv260 carrier board

#### Preamble
MACHINEOVERRIDES =. "${@['', 'k26-kv:']['k26-kv' != '${MACHINE}']}"
#### Regular settings follow

require conf/machine/k26-smk.conf

UBOOT_DT_FILES = "\
    zynqmp-sck-kv-g-revA.dts \
    zynqmp-sck-kv-g-revB.dts \
    "

IMAGE_BOOT_FILES += " devicetree/SMK-zynqmp-sck-kv-g-revB.dtb;system.dtb"

QB_OPT_APPEND += " -blockdev filename=${DEPLOY_DIR_IMAGE}/kv-eeprom.bin,node-name=i2c1.eeprom-51,driver=file"

QB_ROOTFS_OPT = "-drive file=@ROOTFS@,if=sd,format=raw,index=1"

#### No additional settings should be after the Postamble
#### Postamble
PACKAGE_EXTRA_ARCHS:append = "${@['', ' k26_kv']['k26-kv' != "${MACHINE}"]}"
```

## conf/machine/k26-sm-sdt.conf
```bitbake
#@TYPE: Machine
#@NAME: k26-sm-sdt
#@DESCRIPTION: Machine configuration for the AMD Kria K26 SOM (Zynq UltraScale+ MPSoC with Mali-400 GPU and H.264/H.265 VCU): Cortex-A53 Linux plus Cortex-R5 FreeRTOS/baremetal and MicroBlaze PMU sub-machines, built from system device tree.

BBMULTICONFIG += "k26-sm-sdt-cortexa53-fsbl k26-sm-sdt-cortexr5-0-freertos k26-sm-sdt-cortexr5-1-baremetal k26-sm-sdt-microblaze-pmu"

#### Preamble
MACHINEOVERRIDES =. "${@['', 'k26-sm-sdt:']['k26-sm-sdt' !='${MACHINE}']}"
#### Regular settings follow
TUNEFILE[microblaze-pmu] = "conf/machine/include/k26-sm-sdt/microblaze.inc"

# First Stage Boot Loader
FSBL_DEPENDS = ""
FSBL_MCDEPENDS = "mc::k26-sm-sdt-cortexa53-fsbl:fsbl-firmware:do_deploy"
FSBL_DEPLOY_DIR = "${TMPDIR}-k26-sm-sdt-cortexa53-fsbl/deploy/images/${MACHINE}"

# PMU Firmware
PMU_DEPENDS = ""
PMU_MCDEPENDS = "mc::k26-sm-sdt-microblaze-pmu:pmu-firmware:do_deploy"
PMU_FIRMWARE_DEPLOY_DIR = "${TMPDIR}-k26-sm-sdt-microblaze-pmu/deploy/images/${MACHINE}"

# Set the default (linux) domain device tree
CONFIG_DTFILE_DIR := "${@bb.utils.which(d.getVar('BBPATH'), 'conf/dts/k26-sm-sdt')}"
CONFIG_DTFILE ?= "${CONFIG_DTFILE_DIR}/cortexa53-linux.dts"
CONFIG_DTFILE[vardepsexclude] += "CONFIG_DTFILE_DIR"

DTB_FILE_PATH ?= "${RECIPE_SYSROOT}/boot/devicetree/${@os.path.basename(d.getVar('CONFIG_DTFILE').replace('.dts', '.dtb'))}"

# Serial Console Settings
SERIAL_CONSOLES ?= "115200;ttyPS0"

# Yocto arm-trusted-firmware(TF-A) variables
TFA_CONSOLE ?= "cadence1"
TFA_BL33_LOAD ?= "0x8000000"

# Yocto u-boot-xlnx variables

# Set DDR Base address for u-boot-xlnx-scr variables
DDR_BASEADDR ?= "0x0"
SKIP_APPEND_BASEADDR ?= "0"

# Yocto KERNEL Variables
UBOOT_ENTRYPOINT ?= "0x200000"
UBOOT_LOADADDRESS ?= "0x200000"

# Yocto MACHINE_FEATURES Variable
MACHINE_FEATURES += "mali400 vcu fpga-overlay efi"

# Yocto IMAGE_FEATURES Variable
MACHINE_HWCODECS = "libvcu-omxil"
IMAGE_FEATURES += "hwcodecs"

# Required generic machine inclusion
require conf/machine/include/k26-sm.inc

# Default to K26 + KV260
require conf/machine/include/kria-qemu-kv.inc
QEMU_FLASH_TYPE = "qspi"
QEMU_FLASH_FILE = "kria-qspi-${MACHINE}"
# QSPI flash size (64MB)
SPI_IMAGE_SIZE = "0x400_0000"
# QSPI Boots from offset (0x20_0000)
QEMU_HW_FLASH:append = " -boot multiboot=${@int(int('0x20_0000', 0) / ( 32 * 1024))}"

# This is an 'SDT' based BSP
XILINX_WITH_ESW = "sdt"

# Original SDT artifacts URL
SDT_URI = "https://edf.amd.com/sswreleases/rel-v2026.1/sdt/2026.1/2026.1_0609_1_06092108/external/k26-sm-sdt/k26-sm-sdt_2026.1_0609_1_06092108.tar.gz"
SDT_URI[sha256sum] = "e6f7bf59c78a5eb83068048dfa1ec246bbff61ac57be57bc64df67d06b8446f8"
SDT_URI[S] = "${WORKDIR}/k26-sm-sdt_2026.1_0609_1_06092108"

# Set the system device trees
SYSTEM_DTFILE_DEPENDS = "sdt-artifacts"
SYSTEM_DTFILE_DIR = "${RECIPE_SYSROOT}${datadir}/sdt/${MACHINE}"
SYSTEM_DTFILE = "${SYSTEM_DTFILE_DIR}/system-top.dts"

# Load the dynamic machine features
include conf/machine/include/k26-sm-sdt/${BB_CURRENT_MC}-features.conf
LIBXIL_CONFIG = "conf/machine/include/k26-sm-sdt/${BB_CURRENT_MC}-libxil.conf"

# Primary Bootmode value
DEFAULT_HW_BOOT_MODE = "2"

# Update bootbin to use proper device tree
BIF_PARTITION_IMAGE[device-tree] = "${DTB_FILE_PATH}"

# Remap boot files to ensure the right device tree is listed first
IMAGE_BOOT_FILES =+ "devicetree/${@os.path.basename(d.getVar('CONFIG_DTFILE').replace('.dts', '.dtb'))}"

#### No additional settings should be after the Postamble
#### Postamble
PACKAGE_EXTRA_ARCHS:append = "${@['', ' k26_sm_sdt']['k26-sm-sdt' != '${MACHINE}']}"
```

## conf/machine/k26-sm.conf
```bitbake
#@TYPE: Machine
#@NAME: Generic k26-sm
#@DESCRIPTION: Kria K26 SM Production SOM

require include/k26-sm.inc

# This is an 'XSCT' based BSP
XILINX_XSCT_VERSION = "2025.2"
XILINX_WITH_ESW = "xsct"

# Add system XSA
HDF_URI = 'https://edf.amd.com/sswreleases/rel-v2025.2/hdf-examples/2025.2/2025.2_1115_1_11150546/external/k26-sm/k26-sm-2025.2_1115_1.xsa'
HDF_URI[sha256sum] = 'a4c4c8d9beb1a12b2c03ac403fcd78b9bb99f5645df650fa6ac4186729913132'
```

## conf/machine/k26-smk-kr-sdt-multidomain.conf
```bitbake
#@TYPE: Machine
#@NAME: k26-smk-kr-sdt-multidomain
#@DESCRIPTION: AMP/multidomain machine for the AMD Kria KR260 Robotics Starter Kit (K26 SOM): Cortex-A53 Linux plus Cortex-A53 baremetal, Cortex-R5 FreeRTOS/baremetal, and MicroBlaze PMU sub-machines, built from system device tree.

BBMULTICONFIG += "k26-smk-kr-sdt-multidomain-cortexa53-fsbl k26-smk-kr-sdt-multidomain-cortexa53-0-baremetal k26-smk-kr-sdt-multidomain-cortexr5-0-freertos k26-smk-kr-sdt-multidomain-cortexr5-1-baremetal k26-smk-kr-sdt-multidomain-microblaze-pmu"
MACHINEOVERRIDES .= ":k26-smk-kr-sdt"

#### Preamble
MACHINEOVERRIDES =. "${@['', 'k26-smk-kr-sdt-multidomain:']['k26-smk-kr-sdt-multidomain' !='${MACHINE}']}"
#### Regular settings follow
TUNEFILE[microblaze-pmu] = "conf/machine/include/k26-smk-kr-sdt-multidomain/microblaze.inc"

# First Stage Boot Loader
FSBL_DEPENDS = ""
FSBL_MCDEPENDS = "mc::k26-smk-kr-sdt-multidomain-cortexa53-fsbl:fsbl-firmware:do_deploy"
FSBL_DEPLOY_DIR = "${TMPDIR}-k26-smk-kr-sdt-multidomain-cortexa53-fsbl/deploy/images/${MACHINE}"

# PMU Firmware
PMU_DEPENDS = ""
PMU_MCDEPENDS = "mc::k26-smk-kr-sdt-multidomain-microblaze-pmu:pmu-firmware:do_deploy"
PMU_FIRMWARE_DEPLOY_DIR = "${TMPDIR}-k26-smk-kr-sdt-multidomain-microblaze-pmu/deploy/images/${MACHINE}"

# Set the default (linux) domain device tree
CONFIG_DTFILE_DIR := "${@bb.utils.which(d.getVar('BBPATH'), 'conf/dts/k26-smk-kr-sdt-multidomain')}"
CONFIG_DTFILE ?= "${CONFIG_DTFILE_DIR}/cortexa53-linux.dts"
CONFIG_DTFILE[vardepsexclude] += "CONFIG_DTFILE_DIR"

# Device tree binary for boot image
DTB_FILE_PATH ?= "${RECIPE_SYSROOT}/boot/devicetree/SMK-zynqmp-sck-kr-g-revB.dtb"

# Serial Console Settings
SERIAL_CONSOLES ?= "115200;ttyPS0"

# Yocto arm-trusted-firmware(TF-A) variables
TFA_CONSOLE ?= "cadence1"
TFA_BL33_LOAD ?= "0x8000000"

# Yocto u-boot-xlnx variables

# Set DDR Base address for u-boot-xlnx-scr variables
DDR_BASEADDR ?= "0x0"
SKIP_APPEND_BASEADDR ?= "0"

# Yocto KERNEL Variables
UBOOT_ENTRYPOINT ?= "0x200000"
UBOOT_LOADADDRESS ?= "0x200000"

# Yocto MACHINE_FEATURES Variable
MACHINE_FEATURES += "mali400 vcu fpga-overlay efi"

# Yocto IMAGE_FEATURES Variable
MACHINE_HWCODECS = "libvcu-omxil"
IMAGE_FEATURES += "hwcodecs"

# Required generic machine inclusion
require conf/machine/include/k26-smk.inc

# K26 + KR260
require conf/machine/include/kria-qemu-kr.inc
UBOOT_DT_FILES = " zynqmp-sck-kr-g-revA.dtso zynqmp-sck-kr-g-revB.dtso "
DTB_FILE_NAME:task-install:pn-device-tree:linux = "${UBOOT_DTFILE_PREFIX}-zynqmp-sck-kr-g-revB.dtb"
DTB_FILE_NAME:task-deploy:pn-device-tree:linux = "${UBOOT_DTFILE_PREFIX}-zynqmp-sck-kr-g-revB.dtb"
PR:append:pn-device-tree = ".2"
QEMU_FLASH_TYPE = "qspi"
QEMU_FLASH_FILE = "kria-qspi-${MACHINE}"
# QSPI flash size (64MB)
SPI_IMAGE_SIZE = "0x400_0000"
# QSPI Boots from offset (0x20_0000)
QEMU_HW_FLASH:append = " -boot multiboot=${@int(int('0x20_0000', 0) / ( 32 * 1024))}"
# Baremetal Image-recovery requires xilffs with ramfs support
PACKAGECONFIG:append:pn-xilffs = " ramfs"

# This is an 'SDT' based BSP
XILINX_WITH_ESW = "sdt"

# Original SDT artifacts URL
SDT_URI = "https://edf.amd.com/sswreleases/rel-v2026.1/sdt/2026.1/2026.1_0609_1_06092108/external/k26-smk-kr-sdt/k26-smk-kr-sdt_2026.1_0609_1_06092108.tar.gz"
SDT_URI[sha256sum] = "e0bd459b8f7bbee7b654f3bb88d56f2071e33e7f60e641f09c3f3c3c7e6262f3"
SDT_URI[S] = "${WORKDIR}/k26-smk-kr-sdt_2026.1_0609_1_06092108"

# Set the system device trees
SYSTEM_DTFILE_DEPENDS = "sdt-artifacts"
SYSTEM_DTFILE_DIR = "${RECIPE_SYSROOT}${datadir}/sdt/${MACHINE}"
SYSTEM_DTFILE = "${SYSTEM_DTFILE_DIR}/system-top.dts"

# Load the dynamic machine features
include conf/machine/include/k26-smk-kr-sdt-multidomain/${BB_CURRENT_MC}-features.conf
LIBXIL_CONFIG = "conf/machine/include/k26-smk-kr-sdt-multidomain/${BB_CURRENT_MC}-libxil.conf"

# Primary Bootmode value
DEFAULT_HW_BOOT_MODE = "2"

# Update bootbin to use proper device tree
BIF_PARTITION_IMAGE[device-tree] = "${DTB_FILE_PATH}"

# Remap boot files to ensure the right device tree is listed first
IMAGE_BOOT_FILES =+ "devicetree/${@os.path.basename(d.getVar('CONFIG_DTFILE').replace('.dts', '.dtb'))}"
PACKAGE_EXTRA_ARCHS:append = " k26_smk_kr_sdt"

#### No additional settings should be after the Postamble
#### Postamble
PACKAGE_EXTRA_ARCHS:append = "${@['', ' k26_smk_kr_sdt_multidomain']['k26-smk-kr-sdt-multidomain' != '${MACHINE}']}"
```
