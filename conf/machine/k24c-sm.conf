## conf/machine/k26-smk-kv-sdt.conf
```bitbake
#@TYPE: Machine
#@NAME: k26-smk-kv-sdt
#@DESCRIPTION: Machine configuration for the k26-smk-kv-sdt boards.

BBMULTICONFIG += "k26-smk-kv-sdt-cortexa53-fsbl k26-smk-kv-sdt-microblaze-pmu"

#### Preamble
MACHINEOVERRIDES =. "${@['', 'k26-smk-kv-sdt:']['k26-smk-kv-sdt' !='${MACHINE}']}"
#### Regular settings follow
TUNEFILE[microblaze-pmu] = "conf/machine/include/k26-smk-kv-sdt/microblaze.inc"

# First Stage Boot Loader
FSBL_DEPENDS = ""
FSBL_MCDEPENDS = "mc::k26-smk-kv-sdt-cortexa53-fsbl:fsbl-firmware:do_deploy"
FSBL_DEPLOY_DIR = "${TMPDIR}-k26-smk-kv-sdt-cortexa53-fsbl/deploy/images/${MACHINE}"

# PMU Firware
PMU_DEPENDS = ""
PMU_MCDEPENDS = "mc::k26-smk-kv-sdt-microblaze-pmu:pmu-firmware:do_deploy"
PMU_FIRMWARE_DEPLOY_DIR = "${TMPDIR}-k26-smk-kv-sdt-microblaze-pmu/deploy/images/${MACHINE}"

# Set the default (linux) domain device tree
CONFIG_DTFILE_DIR := "${@bb.utils.which(d.getVar('BBPATH'), 'conf/dts/k26-smk-kv-sdt')}"
CONFIG_DTFILE ?= "${CONFIG_DTFILE_DIR}/cortexa53-linux.dts"
CONFIG_DTFILE[vardepsexclude] += "CONFIG_DTFILE_DIR"

# Yocto arm-trusted-firmware(TF-A) variables
TFA_CONSOLE ?= "cadence1"
TFA_BL33_LOAD ?= "0x8000000"

# Set DDR Base address for u-boot-xlnx-scr variables
DDR_BASEADDR ?= "0x0"
SKIP_APPEND_BASEADDR ?= "0"

# Yocto KERNEL Variables
UBOOT_ENTRYPOINT  ?= "0x200000"
UBOOT_LOADADDRESS ?= "0x200000"

# Yocto MACHINE_FEATURES Variable
MACHINE_FEATURES += "mali400 vcu fpga-overlay"

# Yocto IMAGE_FEATURES Variable
MACHINE_HWCODECS = "libvcu-omxil"
IMAGE_FEATURES += "hwcodecs"

# Required generic machine inclusion
require conf/machine/include/k26-smk.inc

require conf/machine/include/kria-qemu-kv.inc

INITRAMFS_IMAGE ?= "petalinux-initramfs-image"
UBOOT_DT_FILES = "\
    zynqmp-sck-kv-g-revA.dtso \
    zynqmp-sck-kv-g-revB.dtso \
    "
DTB_FILE_NAME:task-install:pn-device-tree = "${UBOOT_DTFILE_PREFIX}-zynqmp-sck-kv-g-revB.dtb"
DTB_FILE_NAME:task-deploy:pn-device-tree = "${UBOOT_DTFILE_PREFIX}-zynqmp-sck-kv-g-revB.dtb"
PR:append:pn-device-tree = ".1"


# This is an 'SDT' based BSP
XILINX_WITH_ESW = "sdt"

# Original SDT artifacts URL
SDT_URI = "https://petalinux.xilinx.com/sswreleases/rel-v2025.1/sdt/2025.1/2025.1_0517_1_05172122/external/k26-smk-kv-sdt/k26-smk-kv-sdt_2025.1_0517_1.tar.gz"
SDT_URI[sha256sum] = "8a15d8cfc4142463e52b3afd55b5dec0d5e6e13300bf5590656b595fca61520b"
SDT_URI[S] = "${WORKDIR}/k26-smk-kv-sdt_2025.1_0517_1"

# Set the system device trees
SYSTEM_DTFILE_DEPENDS = "sdt-artifacts"
SYSTEM_DTFILE_DIR = "${RECIPE_SYSROOT}${datadir}/sdt/${MACHINE}"
SYSTEM_DTFILE = "${SYSTEM_DTFILE_DIR}/system-top.dts"

# Load the dynamic machine features
include conf/machine/include/k26-smk-kv-sdt/${BB_CURRENT_MC}-features.conf
LIBXIL_CONFIG = "conf/machine/include/k26-smk-kv-sdt/${BB_CURRENT_MC}-libxil.conf"

# Update bootbin to use proper device tree
BIF_PARTITION_IMAGE[device-tree] = "${RECIPE_SYSROOT}/boot/devicetree/${@os.path.basename(d.getVar('CONFIG_DTFILE').replace('.dts', '.dtb'))}"

# Remap boot files to ensure the right device tree is listed first
IMAGE_BOOT_FILES =+ "devicetree/${@os.path.basename(d.getVar('CONFIG_DTFILE').replace('.dts', '.dtb'))}"

#### No additional settings should be after the Postamble
#### Postamble
PACKAGE_EXTRA_ARCHS:append = "${@['', ' k26_smk_kv_sdt']['k26-smk-kv-sdt' != '${MACHINE}']}"
```

## conf/machine/k26-smk-kv.conf
```bitbake
#@TYPE: Machine
#@NAME: Generic Kria KV260 Vision AI Starter Kit
#@DESCRIPTION: Machine configuration for Kria KV260 Vision AI Starter Kit (Kria K26 SOM + KV260 carrier board).

#### Preamble
MACHINEOVERRIDES =. "${@['', 'k26-smk-kv:']['k26-smk-kv' != '${MACHINE}']}"
MACHINEOVERRIDES =. "k26-kv:"
#### Regular settings follow

require conf/machine/include/k26-smk.inc
require conf/machine/include/kria-qemu-kv.inc

INITRAMFS_IMAGE ?= "petalinux-initramfs-image"

# This is an 'XSCT' based BSP
XILINX_XSCT_VERSION = "2025.2"
XILINX_WITH_ESW = "xsct"

# Add system XSA
HDF_URI = 'https://edf.amd.com/sswreleases/rel-v2025.2/hdf-examples/2025.2/2025.2_1115_1_11150546/external/k26-smk-kv/k26-smk-kv-2025.2_1115_1.xsa'
HDF_URI[sha256sum] = 'efa21f466639e2bf5045734e472709d247a6cea5218b875dcc2d2aa4dfe37a3c'

UBOOT_DT_FILES = "\
    zynqmp-sck-kv-g-revA.dtso \
    zynqmp-sck-kv-g-revB.dtso \
    "

# DTB_FILE_NAME cant be changed globally or it will break the build but we can modify it for these
# tasks specifically so that the resulting symlink points to the correct file for a specific board
DTB_FILE_NAME:task-install:pn-device-tree:linux = "${UBOOT_DTFILE_PREFIX}-zynqmp-sck-kv-g-revB.dtb"
DTB_FILE_NAME:task-deploy:pn-device-tree:linux = "${UBOOT_DTFILE_PREFIX}-zynqmp-sck-kv-g-revB.dtb"
# Workaround for bitbake not detecting the above change in the hash
PR:append:pn-device-tree = ".1"

#### No additional settings should be after the Postamble
#### Postamble
PACKAGE_EXTRA_ARCHS:append = "${@['', ' k26_smk_kv']['k26-smk-kv' != "${MACHINE}"]}"
```

## conf/machine/k26-smk.conf
```bitbake
#@TYPE: Machine
#@NAME: Generic Kria Starter Kit
#@DESCRIPTION: Kria K26 SOM + Starter kit

require include/k26-smk.inc

# This is an 'XSCT' based BSP
XILINX_XSCT_VERSION = "2025.2"
XILINX_WITH_ESW = "xsct"

# Set Image Recovery Depends for XSCT machine
IMGRCRY_DEPENDS = "${@'image-recovery-make:do_deploy' if d.getVar('XILINX_WITH_ESW') == 'xsct' else ''}"

# Add system XSA
HDF_URI = 'https://edf.amd.com/sswreleases/rel-v2025.2/hdf-examples/2025.2/2025.2_1115_1_11150546/external/k26-smk/k26-smk-2025.2_1115_1.xsa'
HDF_URI[sha256sum] = '83bc1de18afce04f226f78c367c5d9cbe039ffc4b36391ed8bd25252a75c31f9'

# NOTE: For K26 starterkit QEMU to boot it needs to have a carrier card configured. The default
# card is set to KV260, but this can be changed by commenting out the lines below and uncomminting
# the KR260 settings.

# K26 + KV260
require include/kria-qemu-kv.inc

# K26 + KR260
#require include/kria-qemu-kr.inc
#

#FPGA manager Variables
MACHINE_FEATURES += "fpga-overlay"
```

## conf/machine/k26-som.conf
```bitbake
#@TYPE: Machine
#@NAME: Generic k26-som
#@DESCRIPTION: Kria K26 SOM

#### Preamble
MACHINEOVERRIDES =. "${@['', 'k26-som:']['k26-som' != '${MACHINE}']}"
MACHINEOVERRIDES =. "k26:"
#### Regular settings follow

SOC_VARIANT ?= "ev"

require conf/machine/zynqmp-generic.conf

MACHINE_HWCODECS = "libomxil-xlnx"

#pmu-firmware variables
extra_settings:pn-pmu-firmware = ""
YAML_COMPILER_FLAGS:append:pn-pmu-firmware = " ${extra_settings}"
YAML_SERIAL_CONSOLE_STDIN:pn-pmu-firmware = "psu_uart_1"
YAML_SERIAL_CONSOLE_STDOUT:pn-pmu-firmware = "psu_uart_1"

#fsbl variables
YAML_SERIAL_CONSOLE_STDIN:pn-fsbl-firmware = "psu_uart_1"
YAML_SERIAL_CONSOLE_STDOUT:pn-fsbl-firmware = "psu_uart_1"
compilerflags:pn-fsbl-firmware = "-DFSBL_DEBUG"
YAML_COMPILER_FLAGS:append:pn-fsbl-firmware = " ${compilerflags}"

#FPGA manager Variables
MACHINE_FEATURES += "fpga-overlay"

#EXTRA_IMAGEDEPENDS:append = " virtual/bootloader virtual/fsbl virtual/pmu-firmware arm-trusted-firmware qemu-devicetrees u-boot-zynq-scr virtual/imgsel virtual/uboot-dtb"
EXTRA_IMAGEDEPENDS += "board-id-data"

SPL_BINARY = ""
EXTRA_IMAGEDEPENDS:remove = "virtual/boot-bin "
#PACKAGES_LIST:append = " imgsel"
YAML_DT_BOARD_FLAGS:k26-som = "{BOARD zynqmp-smk-k26-reva}"

YAML_SERIAL_CONSOLE_BAUDRATE = "115200"

SERIAL_CONSOLES = "115200;ttyPS1"

QB_OPT_APPEND = "\
    -nodefaults \
    -hw-dtb ${DEPLOY_DIR_IMAGE}/qemu-hw-devicetrees/multiarch/board-zynqmp-k26-starterkit-virt.dtb \
    ${@qemu_zynqmp_unhalt(d, True)} \
    -device loader,file=${DEPLOY_DIR_IMAGE}/arm-trusted-firmware.elf,cpu-num=0 \
    -device loader,file=${DEPLOY_DIR_IMAGE}/u-boot.elf \
    -device loader,file=${DEPLOY_DIR_IMAGE}/fit-dtb.blob,addr=0x100000,force-raw=on \
    ${@qemu_add_extra_args(d)} \
    -blockdev filename=${DEPLOY_DIR_IMAGE}/som-eeprom.bin,node-name=i2c1.eeprom-50,driver=file \
    -blockdev node-name=pmu-cfg,filename=${DEPLOY_DIR_IMAGE}/pmu-conf.bin,driver=file \
    -global xlnx,zynqmp-boot.drive=pmu-cfg \
    -pmu-args '${QB_PMU_OPT}' \
"

# runqemu assumes the first serial device is used but Kria SOM uses the second, the following line is
# required in order to mark the first serial as inactive as the runqemu serial config is appended
QB_OPT_APPEND += " -serial null"

#### No additional settings should be after the Postamble
#### Postamble
PACKAGE_EXTRA_ARCHS:append = "${@['', ' k26_som']['k26-som' != "${MACHINE}"]}"
```

## conf/machine/k26-starter-kit.conf
```bitbake
#@TYPE: Machine
#@NAME: Generic kv260 Starter Kit
#@DESCRIPTION: Kria K26 SOM + kv260 carrier board

#### Preamble
MACHINEOVERRIDES =. "${@['', 'k26-starter-kit:']['k26-starter-kit' != '${MACHINE}']}"
#### Regular settings follow

require conf/machine/starter-kit-common.inc

IMAGE_BOOT_FILES:append = " devicetree/SMK-*.dtb"

#### No additional settings should be after the Postamble
#### Postamble
PACKAGE_EXTRA_ARCHS:append = "${@['', ' k26_starter_kit']['k26-starter-kit' != "${MACHINE}"]}"
```

## conf/machine/kr260-starter-kit.conf
```bitbake
#@TYPE: Machine
#@NAME: Generic kr260 Starter Kit
#@DESCRIPTION: Kria K26 SOM + kr260 carrier board

#### Preamble
MACHINEOVERRIDES =. "${@['', 'kr260-starter-kit:']['kr260-starter-kit' != '${MACHINE}']}"
MACHINEOVERRIDES =. "k26-kr:"
#### Regular settings follow

require conf/machine/starter-kit-common.inc

IMAGE_BOOT_FILES:append = " devicetree/SMK-zynqmp-sck-kr-g-revB.dtb;system.dtb"

QB_OPT_APPEND += "\
    -device usb-hub,bus=usb3@0xFE200000.0,port=1,id=usb-hub \
    -device usb-storage,bus=usb3@0xFE200000.0,port=1.1,id=usbstick,drive=stick \
    -blockdev filename=${DEPLOY_DIR_IMAGE}/kr-eeprom.bin,node-name=i2c1.eeprom-51,driver=file \
"

QB_ROOTFS_OPT = "-drive file=@ROOTFS@,if=none,format=raw,id=stick"

#### No additional settings should be after the Postamble
#### Postamble
PACKAGE_EXTRA_ARCHS:append = "${@['', ' kr260_starter_kit']['kr260-starter-kit' != "${MACHINE}"]}"
```

## conf/machine/kria-zynqmp-generic.conf
```bitbake
#### Preamble
MACHINEOVERRIDES =. "${@['', 'kria-zynqmp-generic:']['kria-zynqmp-generic' != '${MACHINE}']}"
#### Regular settings follow

require conf/machine/zynqmp-generic.conf
require conf/machine/include/kria-common.inc

# zynqmp-ev features
MACHINE_FEATURES += "mali400 vcu"

MACHINE_HWCODECS = "libomxil"

PREFERRED_PROVIDER_virtual/dtb = "device-tree-precompiled"

INITRAMFS_IMAGE ?= "kria-image-initramfs"
INITRAMFS_FSTYPES += "cpio.gz.u-boot"
RAMDISK_IMAGE1 = "${INITRAMFS_IMAGE}-${MACHINE}.cpio.gz.u-boot"

INITRAMFS_LOAD_MODULES ?= "usb2244.ko usb5744.ko"

IMAGE_BOOT_FILES = "Image ${INITRAMFS_IMAGE}-${MACHINE}.cpio.gz.u-boot boot.scr"
IMAGE_BOOT_FILES += "devicetree/SMK-*.dtb;devicetree/"
IMAGE_BOOT_FILES += "devicetree/*.dtbo;devicetree/"

EXTRA_IMAGEDEPENDS:remove = " \
    board-id-data \
    qemu-devicetrees-native \
    qemu-helper-native:do_addto_recipe_sysroot \
    qemu-system-native \
    qemu-system-native \
    u-boot-xlnx-scr \
    virtual/bootloader \
    "


#### No additional settings should be after the Postamble
#### Postamble
PACKAGE_EXTRA_ARCHS:append = "${@['', ' kria_generic']['kria-zynqmp-generic' != "${MACHINE}"]}"
```

## conf/machine/kv260-starter-kit.conf
```bitbake
#@TYPE: Machine
#@NAME: Generic kv260 Starter Kit
#@DESCRIPTION: Kria K26 SOM + kv260 carrier board

#### Preamble
MACHINEOVERRIDES =. "${@['', 'kv260-starter-kit:']['kv260-starter-kit' != '${MACHINE}']}"
MACHINEOVERRIDES =. "k26-kv:"
#### Regular settings follow

require conf/machine/starter-kit-common.inc

IMAGE_BOOT_FILES:append = " devicetree/SMK-zynqmp-sck-kv-g-revB.dtb;system.dtb"

QB_OPT_APPEND += " -blockdev filename=${DEPLOY_DIR_IMAGE}/kv-eeprom.bin,node-name=i2c1.eeprom-51,driver=file"

QB_ROOTFS_OPT = "-drive file=@ROOTFS@,if=sd,format=raw,index=1"

#### No additional settings should be after the Postamble
#### Postamble
PACKAGE_EXTRA_ARCHS:append = "${@['', ' kv260_starter_kit']['kv260-starter-kit' != "${MACHINE}"]}"
```

## conf/machine/starter-kit-common.inc
```bitbake
require conf/machine/k26-som.conf

UBOOT_DT_FILES ?= "\
    zynqmp-sck-kr-g-revA.dts \
    zynqmp-sck-kr-g-revB.dts \
    zynqmp-sck-kv-g-revA.dts \
    zynqmp-sck-kv-g-revB.dts \
    "

INITRAMFS_IMAGE = "petalinux-initramfs-image"

IMAGE_FSTYPES += " ext4 wic wic.xz wic.qemu-sd"

QB_DEFAULT_FSTYPE = "wic.qemu-sd"

INITRAMFS_FSTYPES = "cpio.gz cpio.gz.u-boot tar.gz"
IMAGE_FSTYPES:pn-${INITRAMFS_IMAGE}:zynqmp = "${INITRAMFS_FSTYPES}"
RAMDISK_IMAGE1 = "${INITRAMFS_IMAGE}-${MACHINE}.cpio.gz.u-boot"

EXTRA_IMAGEDEPENDS:remove = "u-boot-zynq-uenv"
IMAGE_BOOT_FILES = "Image ${INITRAMFS_IMAGE}-${MACHINE}.cpio.gz.u-boot boot.scr"

WKS_FILES = "k26-starter-kit-sd.wks"
```

## meta-kria-bsp/conf/machine/include/k26-sm.inc
```bitbake
MACHINEOVERRIDES =. "${@['', 'k26-sm:']['k26-sm' != '${MACHINE}']}"

require conf/machine/include/k26-kria-common.inc

#### No additional settings should be after the Postamble
#### Postamble
PACKAGE_EXTRA_ARCHS:append = "${@['', ' k26_sm']['k26-sm' != "${MACHINE}"]}"
```

## meta-kria-bsp/conf/machine/include/kria-common.inc
```bitbake
# This file should not use ?=, and should be included AFTER the base soc-variant
MACHINEOVERRIDES =. "kria:"

SPL_BINARY = ""

ATF_CONSOLE ?= "cadence1"

YAML_SERIAL_CONSOLE_BAUDRATE = "115200"

SERIAL_CONSOLES = "115200;ttyPS1"

# Force the board-id-data to be built even when just xilinx-boot is built
DEPENDS:append:pn-xilinx-bootbin = " board-id-data-k24 board-id-data-k26"

EXTRA_IMAGEDEPENDS += "board-id-data-k24  board-id-data-k26"

IMAGE_FSTYPES += " ext4 wic wic.xz wic.qemu-sd"

KERNEL_COMMAND_APPEND ?= "root=LABEL=root"

UBOOT_MACHINE = "xilinx_zynqmp_kria_defconfig"

MACHINE_ESSENTIAL_EXTRA_RDEPENDS += "${PREFERRED_PROVIDER_virtual/dtb}"

# Default values for deploy dirs
FSBL_DEPLOY_DIR ??= "${DEPLOY_DIR_IMAGE}"
PMU_FIRMWARE_DEPLOY_DIR ??= "${DEPLOY_DIR_IMAGE}"
```

## meta-kria-bsp/conf/machine/include/kria-qemu-kv.inc
```bitbake
require kria-qemu-common.inc

QEMU_HW_DTB_PS = "${QEMU_HW_DTB_PATH}/board-zynqmp-kv260.dtb"

QB_OPT_APPEND += "\ 
    -blockdev filename=@DEPLOY_DIR_IMAGE@/kv-eeprom.bin,node-name=i2c1.eeprom-51,driver=file \
    -blockdev filename=@DEPLOY_DIR_IMAGE@/som-k26-eeprom.bin,node-name=i2c1.eeprom-50,driver=file \
"

QB_ROOTFS_OPT = "-drive file=@ROOTFS@,if=sd,format=raw,index=1"
```

## wic/k26-starter-kit-sd.wks
```
# Description: Creates a partitioned SD card image. Boot files
# are located in the first vfat partition. Rootfs will be in second ext4 partition.

# This wks does not use fixed-size partitions - the partitions that are generated will only have a
# small amount of free space. If you wish to use fixed-size partitions please use --fixed-size in
# either of the lines below (--size should be removed).
part /boot --source bootimg-partition --fstype=vfat --no-fstab-update --label boot --active --align 4 --size 100
part / --source rootfs --fstype=ext4 --no-fstab-update --label root --align 4
```

## wic/starter-kit-sd.wks
```
# Description: Creates a partitioned SD card image. Boot files
# are located in the first vfat partition. Rootfs will be in second ext4 partition.

# This wks does not use fixed-size partitions - the partitions that are generated will only have a
# small amount of free space. If you wish to use fixed-size partitions please use --fixed-size in
# either of the lines below (--size should be removed).
part /boot --source bootimg-partition --ondisk mmcblk1 --fstype=vfat --label boot --active --align 4 --size 16
part / --source rootfs --ondisk mmcblk1 --fstype=ext4 --label root --align 4
```
