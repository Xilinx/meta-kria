## conf/machine/include/k26-smk-kv-sdt-multidomain/k26-smk-kv-sdt-multidomain-cortexr5-1-baremetal-features.conf
```bitbake
MACHINE_FEATURES = "avbuf axipmon clockps common coresightps-dcc csudma ddrcpsu dpdma dppsu emacps gpiops iicps ipipsu qspipsu resetps rtcpsu scugic sdps spips sysmonpsu uartps usbpsu video-common wdtps zdma"
```

## conf/machine/k26-smk-kr-sdt.conf
```bitbake
#@TYPE: Machine
#@NAME: k26-smk-kr-sdt
#@DESCRIPTION: Machine configuration for the k26-smk-kr-sdt boards.


BBMULTICONFIG += "k26-smk-kr-sdt-cortexa53-fsbl k26-smk-kr-sdt-cortexr5-0-freertos k26-smk-kr-sdt-microblaze-pmu"

#### Preamble
MACHINEOVERRIDES =. "${@['', 'k26-smk-kr-sdt:']['k26-smk-kr-sdt' !='${MACHINE}']}"
#### Regular settings follow
TUNEFILE[microblaze-pmu] = "conf/machine/include/k26-smk-kr-sdt/microblaze.inc"

# First Stage Boot Loader
FSBL_DEPENDS = ""
FSBL_MCDEPENDS = "mc::k26-smk-kr-sdt-cortexa53-fsbl:fsbl-firmware:do_deploy"
FSBL_DEPLOY_DIR = "${TMPDIR}-k26-smk-kr-sdt-cortexa53-fsbl/deploy/images/${MACHINE}"

# PMU Firware
PMU_DEPENDS = ""
PMU_MCDEPENDS = "mc::k26-smk-kr-sdt-microblaze-pmu:pmu-firmware:do_deploy"
PMU_FIRMWARE_DEPLOY_DIR = "${TMPDIR}-k26-smk-kr-sdt-microblaze-pmu/deploy/images/${MACHINE}"

# Set the default (linux) domain device tree
CONFIG_DTFILE_DIR := "${@bb.utils.which(d.getVar('BBPATH'), 'conf/dts/k26-smk-kr-sdt')}"
CONFIG_DTFILE ?= "${CONFIG_DTFILE_DIR}/cortexa53-linux.dts"
CONFIG_DTFILE[vardepsexclude] += "CONFIG_DTFILE_DIR"

# Yocto arm-trusted-firmware(TF-A) variables
TFA_CONSOLE ?= "cadence1"
TFA_BL33_LOAD ?= "0x8000000"

# Set DDR Base address for u-boot-xlnx-scr variables
DDR_BASEADDR ?= "0x0"
SKIP_APPEND_BASEADDR ?= "0"

# Yocto KERNEL Variables
UBOOT_ENTRYPOINT  ?= "0x200000"
UBOOT_LOADADDRESS ?= "0x200000"

# Yocto MACHINE_FEATURES Variable
MACHINE_FEATURES += "mali400 vcu fpga-overlay"

# Yocto IMAGE_FEATURES Variable
MACHINE_HWCODECS = "libvcu-omxil"
IMAGE_FEATURES += "hwcodecs"

# Required generic machine inclusion
require conf/machine/include/k26-smk.inc

require conf/machine/include/kria-qemu-kr.inc
UBOOT_DT_FILES = " zynqmp-sck-kr-g-revA.dtso zynqmp-sck-kr-g-revB.dtso "
DTB_FILE_NAME:task-install:pn-device-tree:linux = "${UBOOT_DTFILE_PREFIX}-zynqmp-sck-kr-g-revB.dtb"
DTB_FILE_NAME:task-deploy:pn-device-tree:linux = "${UBOOT_DTFILE_PREFIX}-zynqmp-sck-kr-g-revB.dtb"
PR:append:pn-device-tree = ".2"

# This is an 'SDT' based BSP
XILINX_WITH_ESW = "sdt"

# Original SDT artifacts URL
SDT_URI = "https://edf.amd.com/sswreleases/rel-v2026.1/sdt/2026.1/2026.1_1126_1_11270542/external/k26-smk-kr-sdt/k26-smk-kr-sdt_2026.1_1126_1_11270542.tar.gz"
SDT_URI[sha256sum] = "f34a693db0dffd2daad71ef9022c41b785afa31cf4c6102661645fb020ff50c0"
SDT_URI[S] = "${WORKDIR}/k26-smk-kr-sdt_2026.1_1126_1_11270542"

# Set the system device trees
SYSTEM_DTFILE_DEPENDS = "sdt-artifacts"
SYSTEM_DTFILE_DIR = "${RECIPE_SYSROOT}${datadir}/sdt/${MACHINE}"
SYSTEM_DTFILE = "${SYSTEM_DTFILE_DIR}/system-top.dts"

# Load the dynamic machine features
include conf/machine/include/k26-smk-kr-sdt/${BB_CURRENT_MC}-features.conf
LIBXIL_CONFIG = "conf/machine/include/k26-smk-kr-sdt/${BB_CURRENT_MC}-libxil.conf"

# Update bootbin to use proper device tree
BIF_PARTITION_IMAGE[device-tree] = "${RECIPE_SYSROOT}/boot/devicetree/${@os.path.basename(d.getVar('CONFIG_DTFILE').replace('.dts', '.dtb'))}"

# Remap boot files to ensure the right device tree is listed first
IMAGE_BOOT_FILES =+ "devicetree/${@os.path.basename(d.getVar('CONFIG_DTFILE').replace('.dts', '.dtb'))}"

#### No additional settings should be after the Postamble
#### Postamble
PACKAGE_EXTRA_ARCHS:append = "${@['', ' k26_smk_kr_sdt']['k26-smk-kr-sdt' != '${MACHINE}']}"
```

## conf/machine/k26-smk-sdt.conf
```bitbake
#@TYPE: Machine
#@NAME: k26-smk-sdt
#@DESCRIPTION: Machine configuration for the k26-smk-sdt boards.


BBMULTICONFIG += "k26-smk-sdt-cortexa53-fsbl k26-smk-sdt-cortexr5-0-freertos k26-smk-sdt-microblaze-pmu"

#### Preamble
MACHINEOVERRIDES =. "${@['', 'k26-smk-sdt:']['k26-smk-sdt' !='${MACHINE}']}"
#### Regular settings follow
TUNEFILE[microblaze-pmu] = "conf/machine/include/k26-smk-sdt/microblaze.inc"

# First Stage Boot Loader
FSBL_DEPENDS = ""
FSBL_MCDEPENDS = "mc::k26-smk-sdt-cortexa53-fsbl:fsbl-firmware:do_deploy"
FSBL_DEPLOY_DIR = "${TMPDIR}-k26-smk-sdt-cortexa53-fsbl/deploy/images/${MACHINE}"

# PMU Firmware
PMU_DEPENDS = ""
PMU_MCDEPENDS = "mc::k26-smk-sdt-microblaze-pmu:pmu-firmware:do_deploy"
PMU_FIRMWARE_DEPLOY_DIR = "${TMPDIR}-k26-smk-sdt-microblaze-pmu/deploy/images/${MACHINE}"

# Set the default (linux) domain device tree
CONFIG_DTFILE_DIR := "${@bb.utils.which(d.getVar('BBPATH'), 'conf/dts/k26-smk-sdt')}"
CONFIG_DTFILE ?= "${CONFIG_DTFILE_DIR}/cortexa53-linux.dts"
CONFIG_DTFILE[vardepsexclude] += "CONFIG_DTFILE_DIR"

# Yocto arm-trusted-firmware(TF-A) variables
TFA_CONSOLE ?= "cadence1"
TFA_BL33_LOAD ?= "0x8000000"

# Yocto u-boot-xlnx variables
UBOOT_MACHINE ?= "xilinx_zynqmp_virt_defconfig"

# Set DDR Base address for u-boot-xlnx-scr variables
DDR_BASEADDR ?= "0x0"
SKIP_APPEND_BASEADDR ?= "0"

# Yocto KERNEL Variables
UBOOT_ENTRYPOINT  ?= "0x200000"
UBOOT_LOADADDRESS ?= "0x200000"

# Yocto MACHINE_FEATURES Variable
MACHINE_FEATURES += "mali400 vcu fpga-overlay"

# Yocto IMAGE_FEATURES Variable
MACHINE_HWCODECS = "libvcu-omxil"
IMAGE_FEATURES += "hwcodecs"

# Required generic machine inclusion
require conf/machine/include/k26-smk.inc

# Default to K26 + KV260
require conf/machine/include/kria-qemu-kv.inc
# Create fit dtb blob using the Base dtb instead of uboot dtb
SYSTEM_DTB_BLOB = "1"
# Default imgrcry configuration, using fsbl multiconfig
IMGRCRY_DEPENDS = "image-recovery:do_deploy"
IMGRCRY_MCDEPENDS = ""
IMGRCRY_DEPLOY_DIR = "${TOPDIR}/tmp/deploy/images/${MACHINE}/"
IMGRCRY_IMAGE_NAME = "image-recovery-${MACHINE}"

# This is an 'SDT' based BSP
XILINX_WITH_ESW = "sdt"

# Original SDT artifacts URL
SDT_URI = "https://edf.amd.com/sswreleases/rel-v2026.1/sdt/2026.1/2026.1_1228_1_12290000/external/k26-smk-sdt/k26-smk-sdt_2026.1_1228_1_12290000.tar.gz"
SDT_URI[sha256sum] = "b999ede750ec681e250f181ea0956c68e7e49e24f714713db5f263c45f98b692"
SDT_URI[S] = "${WORKDIR}/k26-smk-sdt_2026.1_1228_1_12290000"

# Set the system device trees
SYSTEM_DTFILE_DEPENDS = "sdt-artifacts"
SYSTEM_DTFILE_DIR = "${RECIPE_SYSROOT}${datadir}/sdt/${MACHINE}"
SYSTEM_DTFILE = "${SYSTEM_DTFILE_DIR}/system-top.dts"

# Load the dynamic machine features
include conf/machine/include/k26-smk-sdt/${BB_CURRENT_MC}-features.conf
LIBXIL_CONFIG = "conf/machine/include/k26-smk-sdt/${BB_CURRENT_MC}-libxil.conf"

# Update bootbin to use proper device tree
BIF_PARTITION_IMAGE[device-tree] = "${RECIPE_SYSROOT}/boot/devicetree/${@os.path.basename(d.getVar('CONFIG_DTFILE').replace('.dts', '.dtb'))}"

# Remap boot files to ensure the right device tree is listed first
IMAGE_BOOT_FILES =+ "devicetree/${@os.path.basename(d.getVar('CONFIG_DTFILE').replace('.dts', '.dtb'))}"

#### No additional settings should be after the Postamble
#### Postamble
PACKAGE_EXTRA_ARCHS:append = "${@['', ' k26_smk_sdt']['k26-smk-sdt' != '${MACHINE}']}"
```

## meta-kria-bsp/conf/layer.conf
```bitbake
# We have a conf directory, add to BBPATH
BBPATH .= ":${LAYERDIR}"

# We have a packages directory, add to BBFILES
BBFILES += " \
    ${LAYERDIR}/recipes-*/*/*.bb \
    ${LAYERDIR}/recipes-*/*/*.bbappend \
    "

BBFILES_DYNAMIC += " \
openamp-layer:${LAYERDIR}/dynamic-layers/openamp-layer/recipes-*/*/*.bb \
openamp-layer:${LAYERDIR}/dynamic-layers/openamp-layer/recipes-*/*/*.bbappend \
xilinx-standalone-sdt:${LAYERDIR}/dynamic-layers/xilinx-standalone-sdt/recipes-*/*/*.bb \
xilinx-standalone-sdt:${LAYERDIR}/dynamic-layers/xilinx-standalone-sdt/recipes-*/*/*.bbappend \
xilinx-standalone-sdt:${LAYERDIR}/dynamic-layers/xilinx-standalone-sdt/recipes-*/*.bb \
xilinx-standalone-sdt:${LAYERDIR}/dynamic-layers/xilinx-standalone-sdt/recipes-*/*.bbappend \
xilinx-virtualization:${LAYERDIR}/dynamic-layers/xilinx-virtualization/recipes-*/*/*.bbappend \
"

BBFILE_COLLECTIONS += "kria-bsp"
BBFILE_PRIORITY_kria-bsp = "5"

LAYERSUMMARY_kria-bsp = "AMD Kria SOM and Starter Kit board support"
LAYERDESCRIPTION_kria-bsp = "BSP layer for AMD Kria K24/K26 system-on-modules \
and the KD240 Drives, KR260 Robotics, and KV260 Vision AI Starter Kits: \
machine .conf, machine/domain YAML, device trees, multiconfigs, bootbin, \
u-boot, device-tree, kria-qspi, board firmware and OpenAMP firmware \
examples."
BBFILE_PATTERN_kria-bsp = "^${LAYERDIR}/"
BBFILE_PATTERN_IGNORE_EMPTY_kria-bsp = "1"

LAYERDEPENDS_kria-bsp  = "core xilinx xilinx-standalone kria-core"

LAYERRECOMMENDS_kria-bsp = "jupyter-layer"

LAYERSERIES_COMPAT_kria-bsp = "wrynose"

LAYER_PATH_kria-bsp-layer = "${LAYERDIR}"

PREFERRED_VERSION_imgrcry-make = "${@d.getVar("XILINX_RELEASE_VERSION").replace('v','')}%"
```

## meta-kria-bsp/conf/machine/include/k24-kria-common.inc
```bitbake
MACHINEOVERRIDES =. "k24-kria:"

require conf/machine/zynqmp-generic.conf
require conf/machine/include/kria-common.inc
```

## meta-kria-bsp/conf/machine/include/k26-kria-common.inc
```bitbake
MACHINEOVERRIDES =. "k26-kria:"

MACHINE_HWCODECS = "libvcu-omxil"

require conf/machine/zynqmp-generic.conf
require conf/machine/include/kria-common.inc
```

## meta-kria-core/conf/layer.conf
```bitbake
# We have a conf directory, add to BBPATH
BBPATH .= ":${LAYERDIR}"

# We have a packages directory, add to BBFILES
BBFILES += " \
    ${LAYERDIR}/recipes-*/*/*.bb \
    ${LAYERDIR}/recipes-*/*/*.bbappend \
    "

BBFILE_COLLECTIONS += "kria-core"
BBFILE_PRIORITY_kria-core = "5"

LAYERSUMMARY_kria-core = "AMD Kria core infra and recipes"
LAYERDESCRIPTION_kria-core = "Core (non-BSP) layer for AMD Kria \
products: machine-independent runtime utilities (xmutil, \
xlnx-platformstats, axi-qos, ddr-qos, kria-dashboard), shared across \
the K24/K26 SOMs and Starter Kits."
BBFILE_PATTERN_kria-core = "^${LAYERDIR}/"
BBFILE_PATTERN_IGNORE_EMPTY_kria-core = "1"

LAYERDEPENDS_kria-core = "\
    core \
    xilinx \
    openembedded-layer \
    meta-python \
    "

LAYERRECOMMENDS_kria-core = "\
    jupyter-layer \
    openamp-layer \
    "

LAYERSERIES_COMPAT_kria-core = "wrynose"
```
