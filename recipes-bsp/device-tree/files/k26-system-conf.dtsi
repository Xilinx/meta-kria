/ {
	reserved-memory {
		#address-cells = <2>;
		#size-cells = <2>;
		ranges;

		cma_reserved: cma_reserved@40000000 {
			compatible = "shared-dma-pool";
			reusable;
			reg = <0x0 0x40000000 0x0 0x32000000>; // Start at 1GB, size 800MB
			linux,cma-default;
		};
	};
};
